/*
 * Copyright (c) 2026 Nordic Semiconductor ASA
 *
 * SPDX-License-Identifier: LicenseRef-Nordic-5-Clause
 */

#include <nrf54lm20_cpuapp_internal_partitions.dtsi>

/ {
	chosen {
		zephyr,code-partition = &boot_partition;
	};
};

/* Disable the external flash, as it's not needed
 * for the configuration with secondary slot residing
 * in the internal RRAM.
 */
&mx25r64 {
	status = "disabled";
};
